// https://github.com/Apsu/Canary
canary_layer {
bindings = <
    &kp W &kp L &kp Y &kp P &kp B   &kp Z &kp F &kp O    &kp U     &kp QUOT
    &kp C &kp R &kp S &kp T &kp G   &kp M &kp N &kp E    &kp I     &kp A
    &kp Q &kp J &kp V &kp D &kp K   &kp X &kp H &kp FSLH &kp COMMA &kp DOT
                &mo NAV &kp LSHFT   &kp SPC &mo SYM
>;
};

// https://colemak.com/
colemak_layer {
bindings = <
    &kp Q &kp W &kp F &kp P &kp G   &kp J &kp L &kp U     &kp Y   &kp SEMI
    &kp A &kp R &kp S &kp T &kp D   &kp H &kp N &kp E     &kp I   &kp QUOT
    &kp Z &kp X &kp C &kp V &kp B   &kp K &kp M &kp COMMA &kp DOT &kp FLSH
                &mo NAV &kp LSHFT   &kp SPC &mo SYM
>;
};