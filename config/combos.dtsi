#include "layers.dtsi"

#define ALPHA_LAYERS DEF CAN COL

compatible = "zmk,combos";

#define COMBO(NAME, BINDINGS, KEYPOS, LAYERS) \
  combo_##NAME { \
    bindings = <BINDINGS>; \
    timeout-ms = <30>; \
    key-positions = <KEYPOS>; \
    layers = <LAYERS>; \
  };

#define GLOBAL_COMBO(NAME, BINDINGS, KEYPOS) \
  combo_##NAME { \
    bindings = <BINDINGS>; \
    timeout-ms = <50>; \
    key-positions = <KEYPOS>; \
  };

COMBO(gui, &kp LGUI, 12 13, ALPHA_LAYERS)
COMBO(return_to_alpha_from_game, &to DEF, 1 3, GME)

COMBO(toggle_canary, &to CAN, 5 7 9, ALPHA_LAYERS)
COMBO(toggle_colemak, &to COL, 15 17 19, ALPHA_LAYERS)

COMBO(left_vertical_game_layer_toggle, &to GME, 10 20, ALPHA_LAYERS)
COMBO(right_vertical_game_layer_toggle, &to GME, 19 29, ALPHA_LAYERS)

COMBO(left_vertical_enter, &kp ENTER, 1 11, ALPHA_LAYERS)
COMBO(right_vertical_enter, &kp ENTER, 8 18, ALPHA_LAYERS)

COMBO(left_vertical_escape, &kp ESC, 2 12, ALPHA_LAYERS)
COMBO(right_vertical_escape, &kp ESC, 7 17, ALPHA_LAYERS)

COMBO(left_vertical_delete, &kp DEL, 3 13, ALPHA_LAYERS)
COMBO(right_vertical_delete, &kp DEL, 6 16, ALPHA_LAYERS)

COMBO(left_vertical_backspace, &kp BSPC, 4 14, ALPHA_LAYERS)
COMBO(right_vertical_backspace, &kp BSPC, 5 15, ALPHA_LAYERS)

GLOBAL_COMBO(left_bottom_utility_layer_toggle, &to UTL, 21 22 23)
GLOBAL_COMBO(right_bottom_utility_layer_toggle, &to UTL, 26 27 28)

GLOBAL_COMBO(left_return_to_default, &to DEF, 10 11 12 14)
GLOBAL_COMBO(right_return_to_default, &to DEF, 15 17 18 19)
