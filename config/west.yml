## config/west.yml
```yaml
manifest:
  remotes:
    - name: zmkfirmware
      url-base: https://github.com/zmkfirmware
    - name: nickconway
      url-base: https://github.com/nickconway
    - name: ftc
      url-base: https://github.com/ftc
  projects:
    - name: zmk
      remote: nickconway
      revision: smart-interrupt
      import: app/west.yml
  self:
    path: config
```
